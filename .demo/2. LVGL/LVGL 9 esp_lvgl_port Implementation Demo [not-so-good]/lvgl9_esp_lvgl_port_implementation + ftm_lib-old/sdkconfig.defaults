## .examples/lvglv8_demo_nonfinalised/main/Kconfig.projbuild
```kconfig
menu "LilyGo Display Product Configuration"
    choice LILYGO_DISPLAY_BOARD
        prompt "LilyGo Display Board"
        default LILYGO_T_DISPLAY_S3_AMOLED

        help
            Select LilyGo Display Product

        config LILYGO_T_HMI
            bool "T-HMI 2.8 Inch"
                        
    endchoice

endmenu
```

## components/lvgl/Kconfig
```kconfig
# Kconfig file for LVGL v9.3.0
# Edited by Florin Aurel Baciu

menu "LVGL configuration"

	config LV_CONF_SKIP
		bool "Check this to not use custom lv_conf.h"
		default y

	config LV_CONF_MINIMAL
		bool "LVGL minimal configuration"
		default y


endmenu
```
